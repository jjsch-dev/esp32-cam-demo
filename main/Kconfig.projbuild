## main/Kconfig.projbuild
```kconfig
menu "ESP32 Camera Demo Configuration"
      
config XCLK_FREQ
    int "XCLK Frequency"
    default "20000000"
    help
        The XCLK Frequency in Herz.
        
menu "Pin Configuration"
    config D0
        int "D0"
        default "4"
    config D1
        int "D1"
        default "5"
    config D2
        int "D2"
        default "18"
    config D3
        int "D3"
        default "19"
    config D4
        int "D4"
        default "36"
    config D5
        int "D5"
        default "39"
    config D6
        int "D6"
        default "34"
    config D7
        int "D7"
        default "35"
    config XCLK
        int "XCLK"
        default "21"
    config PCLK
        int "PCLK"
        default "22"
    config VSYNC
        int "VSYNC"
        default "25"
    config HREF
        int "HREF"
        default "23"
    config SDA
        int "SDA"
        default "26"
    config SCL
        int "SCL"
        default "27"
    config RESET
        int "RESET"
        default "2"
endmenu

config ENABLE_TEST_PATTERN
	bool "Enable test pattern on camera output"
	default n
	help
		Configure the camera module to output test pattern instead of live image.
		
		Use this option to troubleshoot image issues like noise,
		distortion, not legible and missing live image.
		Instead, module will generate regular vertical bars 
		in shades from dark to white.

endmenu
```
